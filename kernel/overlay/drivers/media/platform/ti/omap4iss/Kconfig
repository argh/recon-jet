## kernel/overlay/drivers/media/platform/ti/omap4iss/Kconfig
```kconfig
# SPDX-License-Identifier: GPL-2.0
config VIDEO_OMAP4
	tristate "OMAP 4 Camera support (ISS, Recon Jet port)"
	depends on VIDEO_DEV && I2C
	depends on V4L_PLATFORM_DRIVERS
	depends on ARCH_OMAP4 || COMPILE_TEST
	select MEDIA_CONTROLLER
	select VIDEO_V4L2_SUBDEV_API
	select MFD_SYSCON
	select VIDEOBUF2_DMA_CONTIG
	select V4L2_FWNODE
	help
	  Driver for the OMAP4 ISS camera controller (CSI-2 receivers, ISP5
	  resizer path), ported from the removed staging driver with device
	  tree support.
```
